/*
 * CAUTION: This file is automatically generated by Xilinx.
 * Version: HSI 2018.2
 * Today is: Tue Jan 12 19:26:05 2021
 */


/dts-v1/;
/include/ "zynq-7000.dtsi"
/include/ "pcw.dtsi"
/ {
	chosen {
		bootargs = [00];
		stdout-path = "serial0:115200n8";
	};
	aliases {
		ethernet0 = &gem0;
		serial0 = &uart0;
		spi0 = &qspi;
	};
	memory {
		device_type = "memory";
		reg = <0x0 0x20000000>;
	};
};
/include/ "board.dtsi"
